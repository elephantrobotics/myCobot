#include <MyCobotBasic.h>
#include "mycobot_logo.c"
#include <SCServo.h>

MyCobotBasic mycobot;
SMSBL sm;
extern const unsigned char mycobot_start_PIC[29523];
unsigned long t_begin = 0;
double angle[6] = {31.110, 45.870, -103.710, 76.720, -67.850, 104.850};
int pos[149][6] = {{1141, 2452, 620, 1157, 1987, 3985},
    {1142, 2452, 620, 1161, 1993, 3986},
    {1142, 2452, 620, 1162, 1995, 3986},
    {1142, 2452, 620, 1162, 1993, 3986},
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    {1138, 2452, 622, 1155, 1981, 3982}
};

void play();
void ReleaseSevor();

void setup()
{
    mycobot.setup();
    mycobot.powerOn();
    Serial2.begin(1000000);
    sm.pSerial = &Serial2;
    M5.Lcd.drawJpg(mycobot_start_PIC, sizeof(mycobot_start_PIC), 0, 0, 320, 240);
    t_begin = millis();
    mycobot.writeAngles({0, 0, 0, 0, 0, 0}, 50); //开始
    delay(1000);
    while (!mycobot.isInPosition({0, 0, 0, 0, 0, 0}, 0)) {
        delay(500);
        if (t_begin - millis() > 3000)
            break;
    }
    delay(500);
}

void loop()
{
    t_begin = millis();
    mycobot.writeAngles({0, 0, 0, 0, 0, 0}, 50); //开始
    delay(1000);
    while (!mycobot.isInPosition({0, 0, 0, 0, 0, 0}, 0)) {
        delay(500);
        if (t_begin - millis() > 3000)
            break;
    }
    delay(500);
    mycobot.writeAngle(0, 30, 50);
    delay(1000);
    for (int i = 0; i < 5; i++) {
        play();
        delay(500);
    }
    mycobot.writeAngle(1, 0, 50);
    delay(1000);
    mycobot.writeAngles({-31.200, -141.5, 154.680, -153.010, 86.570, -104.850},
                        50);//结束
    delay(4000);
    //ReleaseSevor();
    mycobot.powerOff();
    delay(16000);
}

void play()
{
    int count = 0;
    for (int index = 0 ; index < 149; index++) {
        for (int i = 0; i < 6; i++) {
            if (i == 1)
                sm.WritePosEx(i + 1, pos[index][i] - 300, 800, 50);
            else
                sm.WritePosEx(i + 1, pos[index][i], 800, 50);
        }
        delay(100);
        if (index % 24 == 0) {
            if (count > 6)
                break;
            mycobot.writeAngle(5, 40, 50);
            delay(200);
            mycobot.writeAngle(0, 40, 50);
            delay(200);
            count++;
        }
        Serial.println("Finish Play");
    }
}

void ReleaseSevor()
{
    for (int i = 0; i < 6; i++) {
        mycobot.releaseServo(i);
    }
}
